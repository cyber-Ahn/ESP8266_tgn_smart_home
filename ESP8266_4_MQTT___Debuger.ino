#include <ESP8266WiFi.h>
#include <PubSubClient.h>
#include <Wire.h>
#include "SSD1306Wire.h"

const char* ssid = "name";
const char* wifi_password = "pwd";
const char* mqtt_server = "mqtt ip";

const char* esp1_ip_tp = "tgn/esp_1/connection/ip";
const char* esp1_temp_tp = "tgn/esp_1/temp/sensor_1";
const char* esp1_hum_tp = "tgn/esp_1/temp/sensor_2";
const char* esp1_lis_tp = "tgn/esp_1/analog/sensor_1";
const char* esp2_ip_tp = "tgn/esp_2/connection/ip";
const char* esp2_temp_tp = "tgn/esp_2/temp/sensor_1";
const char* esp2_hum_tp = "tgn/esp_2/temp/sensor_2";
const char* esp2_lis_tp = "tgn/esp_2/analog/sensor_1";
const char* esp3_ip_tp = "tgn/esp_3/connection/ip";
const char* esp3_mode_tp = "tgn/esp_3/neopixel/mode";
const char* esp3_br_tp = "tgn/esp_3/neopixel/brightness";
const char* esp3_col_tp = "tgn/esp_3/neopixel/color";
const char* con_topic = "tgn/esp_4/connection/ip";
const char* update_topic = "tgn/esp_4/update";
String clientID = "NodeMCU_4 V0.2";
const int inLED = D0;
int screen = 0;
String esp1_ip = "---.---.---.---";
String esp1_temp = "00";
String esp1_hum = "00";
String esp1_lis = "--";
String esp2_ip = "---.---.---.---";
String esp2_temp = "00";
String esp2_hum = "00";
String esp2_lis = "--";
String esp3_ip = "---.---.---.---";
String esp3_mode = "empty";
String esp3_br = "00";
String esp3_col = "0.0.0.0";

WiFiClient espClient;
PubSubClient client(espClient);
SSD1306Wire  display(0x3c, D3, D5);

#define WiFi_Logo_width 60
#define WiFi_Logo_height 36
const uint8_t WiFi_Logo_bits[] PROGMEM = {
  0x00, 0x00, 0x00, 0x00, 0x00, 0x00, 0x00, 0x00, 0x00, 0x00, 0x00, 0xF8,
  0x00, 0x00, 0x00, 0x00, 0x00, 0x00, 0x80, 0xFF, 0x07, 0x00, 0x00, 0x00,
  0x00, 0x00, 0xE0, 0xFF, 0x1F, 0x00, 0x00, 0x00, 0x00, 0x00, 0xF8, 0xFF,
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  0x00, 0x00, 0x00, 0x00, 0x00, 0x00, 0x00, 0x00, 0x00, 0x00, 0x00, 0x00,
  };

#define tgn_width 128
#define tgn_height 64
const uint8_t tgn_bits[] PROGMEM = {
  0xFF, 0xFF, 0xFF, 0xFF, 0xFF, 0xFF, 0xFF, 0xFF, 0xFF, 0xFF, 0xFF, 0xFF, 
  0xFF, 0xFF, 0xFF, 0xFF, 0xFF, 0xFF, 0xFF, 0xFF, 0xFF, 0xFF, 0xFF, 0xFF, 
  0xFF, 0xFF, 0xFF, 0xFF, 0xFF, 0xFF, 0xFF, 0xFF, 0xFF, 0xFF, 0xFF, 0xFF, 
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  0xFF, 0xFF, 0xFF, 0xFF, };
 
void setup() {
  Serial.begin(9600);
  Serial.println();
  Serial.print("Connecting to ");
  Serial.println(ssid);
  setup_wifi();
  Serial.println("WiFi connected");
  Serial.print("IP address: ");
  client.setServer(mqtt_server, 1883);
  client.setCallback(callback);
  display.init();
  display.flipScreenVertically();
  display.setContrast(100);
  display.drawXbm(34, 14, WiFi_Logo_width, WiFi_Logo_height, WiFi_Logo_bits);
  display.display();
  delay(5000);
  display.clear();
  display.drawXbm(0, 0, tgn_width, tgn_height, tgn_bits);
  display.display();
  delay(5000);
  display.clear();
  display.display();
  pinMode(inLED, OUTPUT);
  display.setFont(ArialMT_Plain_16);
  display.drawString(0, 0, "Connecting to ");
  display.drawString(0, 16, ssid);
  display.drawString(0, 32, "Brocker IP:");
  display.drawString(0, 48, mqtt_server);
  display.display();
  delay(5000);
  display.clear();
  display.display();
  Serial.println("WiFi connected");
  Serial.print("IP address: ");
  Serial.println(WiFi.localIP());
  Serial.println(WiFi.macAddress());
}

void setup_wifi() {
  WiFi.mode(WIFI_STA);
  WiFi.begin(ssid, wifi_password);
  while (WiFi.status() != WL_CONNECTED) {
    delay(100);
  }
  Serial.println(WiFi.localIP());
}

void reconnect(){
  while (!client.connected()){
  Serial.println("Reconnecting");
  clientID += String(random(0xffff), HEX);
  if(!client.connect(clientID.c_str())){
    Serial.print("faild, rc=");
    Serial.print(client.state());
    Serial.print("retrying in 5 s");
    delay(5000);
    }
  }
}

void callback(char* topic, byte* payload, unsigned int length) {
  digitalWrite(inLED,LOW); 
  
  char msg[length+1];
  for (int i = 0; i < length; i++) {
    msg[i] = (char)payload[i];
  }
  msg[length] = '\0';
  String data = msg;
  
  if(strcmp(topic, esp1_ip_tp) == 0) {
    esp1_ip = data;
  }
  if(strcmp(topic, esp1_temp_tp) == 0) {
    esp1_temp = data;
  }
  if(strcmp(topic, esp1_hum_tp) == 0) {
    esp1_hum = data;
  }
  if(strcmp(topic, esp1_lis_tp) == 0) {
    esp1_lis = data;
  }
  if(strcmp(topic, esp2_ip_tp) == 0) {
    esp2_ip = data;
  }
  if(strcmp(topic, esp2_temp_tp) == 0) {
    esp2_temp = data;
  }
  if(strcmp(topic, esp2_hum_tp) == 0) {
    esp2_hum = data;
  }
  if(strcmp(topic, esp2_lis_tp) == 0) {
    esp2_lis = data;
  }
  if(strcmp(topic, esp3_ip_tp) == 0) {
    esp3_ip = data;
  }
  if(strcmp(topic, esp3_mode_tp) == 0) {
    esp3_mode = data;
  }
  if(strcmp(topic, esp3_br_tp) == 0) {
    esp3_br = data;
  }
  if(strcmp(topic, esp3_col_tp) == 0) {
    esp3_col = data;
  }
  delay(1000);
  digitalWrite(inLED,HIGH);
}
 
void loop() {
  if (!client.connected()) {
    reconnect();
  }
  client.loop();
  char ip_out[50] = "";
  IPAddress ip_r = WiFi.localIP();
  byte first_octet = ip_r[0];
  byte second_octet = ip_r[1];
  byte third_octet = ip_r[2];
  byte fourth_octet = ip_r[3];
  static char ip_a[7];
  static char ip_b[7];
  static char ip_c[7];
  static char ip_d[7];
  dtostrf(first_octet, 2, 0, ip_a);
  dtostrf(second_octet, 2, 0, ip_b);
  dtostrf(third_octet, 1, 0, ip_c);
  dtostrf(fourth_octet, 2, 0, ip_d);
  strcat(ip_out,ip_a);
  strcat(ip_out,".");
  strcat(ip_out,ip_b);
  strcat(ip_out,".");
  strcat(ip_out,ip_c);
  strcat(ip_out,".");
  strcat(ip_out,ip_d);
  display.clear();
  display.display();
  client.publish(con_topic, ip_out, true);
  Serial.println(ip_out);
  if (screen == 0) {
    display.setTextAlignment(TEXT_ALIGN_LEFT);
    display.setContrast(255);
    display.drawString(0, 0, "NodeMCU 1 IP:");
    display.drawString(0, 12, esp1_ip);
    display.drawString(0, 24, "TEMP:          °C");
    display.drawString(35, 24, esp1_temp);
    display.drawString(0, 36, "HUMI:           %");
    display.drawString(35, 36, esp1_hum);
    display.drawString(0, 48, "LIGH:");
    display.drawString(35, 48, esp1_lis);
    display.display();
    Serial.print("NodeMCU 1 IP: ");
    Serial.print(esp1_ip);
    Serial.println();
    Serial.print("TEMP: ");
    Serial.print(esp1_temp);
    Serial.println();
    Serial.print("HUMI: ");
    Serial.print(esp1_hum);
    Serial.println();
    Serial.print("LIGH: ");
    Serial.print(esp1_lis);
    Serial.println();
    screen = 1;
  }
  else if (screen == 1) {
    display.setTextAlignment(TEXT_ALIGN_LEFT);
    display.setContrast(255);
    display.drawString(0, 0, "NodeMCU 2 IP:");
    display.drawString(0, 12, esp2_ip);
    display.drawString(0, 24, "TEMP:          °C");
    display.drawString(35, 24, esp2_temp);
    display.drawString(0, 36, "HUMI:           %");
    display.drawString(35, 36, esp2_hum);
    display.drawString(0, 48, "LIGH:");
    display.drawString(35, 48, esp2_lis);
    display.display();
    Serial.print("NodeMCU 2 IP: ");
    Serial.print(esp2_ip);
    Serial.println();
    Serial.print("TEMP: ");
    Serial.print(esp2_temp);
    Serial.println();
    Serial.print("HUMI: ");
    Serial.print(esp2_hum);
    Serial.println();
    Serial.print("LIGH: ");
    Serial.print(esp2_lis);
    Serial.println();
    screen = 2;
  }
  else if (screen == 2) {
    display.setTextAlignment(TEXT_ALIGN_LEFT);
    display.setContrast(255);
    display.drawString(0, 0, "NodeMCU 3 IP:");
    display.drawString(0, 12, esp3_ip);
    display.drawString(0, 24, "Color:");
    display.drawString(32, 24, esp3_col);
    display.drawString(0, 36, "Brightness:");
    display.drawString(65, 36, esp3_br);
    display.drawString(0, 48, "Mode:");
    display.drawString(35, 48, esp3_mode);
    display.display();
    Serial.print("NodeMCU 3 IP: ");
    Serial.print(esp3_ip);
    Serial.println();
    Serial.print("Color:");
    Serial.print(esp3_col);
    Serial.println();
    Serial.print("Brightness:");
    Serial.print(esp3_br);
    Serial.println();
    Serial.print("Mode:");
    Serial.print(esp3_mode);
    Serial.println();
    screen = 0;
  }
  delay(5000);
}
